## boards/keebart/corne_choc_pro/board.yml
```yaml
boards:
  - name: corne_choc_pro_left
    vendor: keebart
    socs:
      - name: nrf52840
  - name: corne_choc_pro_right
    vendor: keebart
    socs:
      - name: nrf52840
```

## boards/keebart/sofle_choc_pro/board.yml
```yaml
boards:
  - name: sofle_choc_pro_left
    vendor: keebart
    socs:
      - name: nrf52840
  - name: sofle_choc_pro_right
    vendor: keebart
    socs:
      - name: nrf52840
```
