## boards/keebart/corne_choc_pro_5col/Kconfig.corne_choc_pro_5col_right
```kconfig
# Copyright (c) 2020 The ZMK Contributors
# SPDX-License-Identifier: MIT

config BOARD_CORNE_CHOC_PRO_5COL_RIGHT
	select SOC_NRF52840_QIAA
	imply RETAINED_MEM
	imply RETENTION
	imply RETENTION_BOOT_MODE
```

## boards/keebart/corne_choc_pro_5col/board.yml
```yaml
boards:
  - name: corne_choc_pro_5col_left
    vendor: keebart
    socs:
      - name: nrf52840
  - name: corne_choc_pro_5col_right
    vendor: keebart
    socs:
      - name: nrf52840
```

## boards/keebart/piantor_pro_bt/Kconfig.piantor_pro_bt_right
```kconfig
# Copyright (c) 2020 The ZMK Contributors
# SPDX-License-Identifier: MIT

config BOARD_PIANTOR_PRO_BT_RIGHT
	select SOC_NRF52840_QIAA
	imply RETAINED_MEM
	imply RETENTION
	imply RETENTION_BOOT_MODE
```

## boards/keebart/sofle_choc_pro/Kconfig.sofle_choc_pro_left
```kconfig
# Copyright (c) 2020 The ZMK Contributors
# SPDX-License-Identifier: MIT

config BOARD_SOFLE_CHOC_PRO_LEFT
	select SOC_NRF52840_QIAA
```

## boards/keebart/sofle_choc_pro/Kconfig.sofle_choc_pro_right
```kconfig
# Copyright (c) 2020 The ZMK Contributors
# SPDX-License-Identifier: MIT

config BOARD_SOFLE_CHOC_PRO_RIGHT
	select SOC_NRF52840_QIAA
```

## boards/shields/sharp_mip/Kconfig.shield
```kconfig
# Copyright (c) 2022 The ZMK Contributors
# SPDX-License-Identifier: MIT

config SHIELD_SHARP_MIP
    def_bool $(shields_list_contains,sharp_mip)
```

## config/west.yml
```yaml
manifest:
  remotes:
    - name: zmkfirmware
      url-base: https://github.com/zmkfirmware
    - name: Good-Great-Grand-Wonderful
      url-base: https://github.com/Good-Great-Grand-Wonderful
    # Additional modules containing boards/shields/custom code can be listed here as well
    # See https://docs.zephyrproject.org/3.2.0/develop/west/manifest.html#projects
  projects:
    - name: zmk
      remote: zmkfirmware
      revision: v0.3
      import: app/west.yml
    - name: crosses-v2-zmk-firmware
      remote: Good-Great-Grand-Wonderful
      import: config/west.yml
  self:
    path: config
```

## dts/bindings/zmk,input-processor-auto-layer.yaml
```yaml
# SPDX-License-Identifier: MIT

description: |
  Turns a layer on while a pointing device moves; ZMK's temp layer input
  processor with its state kept per instance (see
  src/input_processor_auto_layer.c).

compatible: "zmk,input-processor-auto-layer"

include: ip_two_param.yaml

properties:
  require-prior-idle-ms:
    type: int
    default: 0
    description: Input within this many ms of a keystroke doesn't turn the layer on

  excluded-positions:
    type: array
    default: []
    description: Key positions that don't turn the layer off when pressed
```
